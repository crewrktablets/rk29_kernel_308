## drivers/media/video/isp/Kconfig
```kconfig
# Kconfig for OMAP3 ISP driver

config VIDEO_OMAP34XX_ISP_PREVIEWER
	tristate "OMAP ISP Previewer"
	depends on !ARCH_OMAP3410 && VIDEO_OMAP3

config VIDEO_OMAP34XX_ISP_RESIZER
	tristate "OMAP ISP Resizer"
	depends on !ARCH_OMAP3410 && VIDEO_OMAP3

config VIDEO_OMAP34XX_OV7675_ISP_GLUE
	tristate "OMAP3 ISP <-> OV7675 (A32 CAM) Glue"
	select VIDEO_OMAP3
	select VIDEO_OV7675

config VIDEO_OMAP34XX_MT9D113_ISP_GLUE
	tristate "OMAP3 ISP <-> MT9D113 (A43 CAM) Glue"
	select VIDEO_OMAP3
	select VIDEO_MT9D113
```

## drivers/video/logo/Kconfig
```kconfig
#
# Logo configuration
#

menuconfig LOGO
	bool "Bootup logo"
	depends on FB || SGI_NEWPORT_CONSOLE
	help
	  Enable and select frame buffer bootup logos.

if LOGO

config FB_LOGO_EXTRA
	bool
	depends on FB=y
	default y if SPU_BASE

choice 
	prompt "Select Boot Logo"
	default LOGO_LOOX_CLUT224

	config LOGO_LINUX_MONO
		bool "Standard black and white Linux logo"

	config LOGO_LINUX_VGA16
		bool "Standard 16-color Linux logo"

	config LOGO_LINUX_CLUT224
		bool "Standard 224-color Linux logo"
	
	config LOGO_LOOX_CLUT224
		bool "Odys LOOX logo"

	config LOGO_LOOXPLUS_CLUT224
		bool "Odys LOOX Plus logo"

	config LOGO_NEXT_CLUT224
		bool "Odys Next logo"

	config LOGO_XPRESS_CLUT224
		bool "Odys XPRESS logo"

	config LOGO_CRK29_CLUT224
		bool "CrewRkTablets logo for RK29 device"

	config LOGO_N90_CLUT224
		bool "Standard 224-color Linux logo for N90"

	config LOGO_BLACKFIN_VGA16
		bool "16-colour Blackfin Processor Linux logo"
		depends on BLACKFIN

	config LOGO_BLACKFIN_CLUT224
		bool "224-colour Blackfin Processor Linux logo"
		depends on BLACKFIN

	config LOGO_DEC_CLUT224
		bool "224-color Digital Equipment Corporation Linux logo"
		depends on MACH_DECSTATION || ALPHA

	config LOGO_MAC_CLUT224
		bool "224-color Macintosh Linux logo"
		depends on MAC

	config LOGO_PARISC_CLUT224
		bool "224-color PA-RISC Linux logo"
		depends on PARISC

	config LOGO_SGI_CLUT224
		bool "224-color SGI Linux logo"
		depends on SGI_IP22 || SGI_IP27 || SGI_IP32 || X86_VISWS

	config LOGO_SUN_CLUT224
		bool "224-color Sun Linux logo"
		depends on SPARC

	config LOGO_SUPERH_MONO
		bool "Black and white SuperH Linux logo"
		depends on SUPERH

	config LOGO_SUPERH_VGA16
		bool "16-color SuperH Linux logo"
		depends on SUPERH

	config LOGO_SUPERH_CLUT224
		bool "224-color SuperH Linux logo"
		depends on SUPERH

	config LOGO_M32R_CLUT224
		bool "224-color M32R Linux logo"
		depends on M32R

	config LOGO_CHARGER_CLUT224
		bool "standard 224-color linux logo for rk2918 phone"

	config LOGO_G3_CLUT224
		bool "Standard 224-color Linux logo for g3 phone"

endchoice

endif # LOGO
```
